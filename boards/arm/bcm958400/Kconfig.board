## boards/arm/bcm958400/Kconfig.board
```kconfig
#
# SPDX-License-Identifier: Apache-2.0
#
# Copyright 2019 Broadcom
#

config BOARD_BRCM_VALKYRIE_BCM958400
	bool "Broadcom Valkyrie SoC BCM958400 board"
	depends on SOC_BCM58400
```

## boards/arm/bcm958400/Kconfig.defconfig
```kconfig
# SPDX-License-Identifier: Apache-2.0
#
# Copyright 2019 Broadcom
#

if BOARD_BRCM_VALKYRIE_BCM958400

config BOARD
	default "bcm958400"

endif # BOARD_BRCM_VALKYRIE_BCM958400
```

## boards/arm/bcm958400/bcm958400_defconfig
```kconfig
# SPDX-License-Identifier: Apache-2.0

CONFIG_ARM=y
CONFIG_SOC_FAMILY_BRCM_VK=y
CONFIG_SOC_SERIES_VALKYRIE=y
CONFIG_SOC_BCM58400=y
CONFIG_BOARD_BRCM_VALKYRIE_BCM958400=y

CONFIG_XIP=n
CONFIG_MAIN_STACK_SIZE=2048
CONFIG_INIT_STACKS=y

CONFIG_SCHED_MULTIQ=y
CONFIG_SCHED_DUMB=n
CONFIG_BOOT_BANNER=y
CONFIG_ASSERT=y

CONFIG_CONSOLE=y
CONFIG_SERIAL=y
CONFIG_UART_NS16550=y
CONFIG_UART_CONSOLE=y
CONFIG_UART_NS16550_PORT_0=y

CONFIG_NUM_PREEMPT_PRIORITIES=0
CONFIG_SYSTEM_WORKQUEUE_PRIORITY=-2
CONFIG_HEAP_MEM_POOL_SIZE=16384
CONFIG_THREAD_NAME=y

CONFIG_SHELL=y
```

## boards/arm/bcm958402m2_a72/bcm958402m2_a72_defconfig
```kconfig
# SPDX-License-Identifier: Apache-2.0

# Platform Configuration
CONFIG_SOC_SERIES_VIPER=y
CONFIG_SOC_BCM58402_A72=y
CONFIG_BOARD_BCM958402M2_A72=y

# Zephyr Kernel Configuration
CONFIG_XIP=n
CONFIG_FLASH_SIZE=0
CONFIG_FLASH_BASE_ADDRESS=0x0
CONFIG_SCHED_MULTIQ=y
CONFIG_SCHED_DUMB=n
CONFIG_NUM_PREEMPT_PRIORITIES=0
CONFIG_HEAP_MEM_POOL_SIZE=16384
CONFIG_THREAD_NAME=y

# Serial Drivers
CONFIG_SERIAL=y
CONFIG_UART_INTERRUPT_DRIVEN=y
CONFIG_UART_NS16550=y

# Enable Console
CONFIG_CONSOLE=y
CONFIG_UART_CONSOLE=y

# Enable Shell
CONFIG_SHELL=y
```

## soc/arm/brcm_vk/Kconfig
```kconfig
#
# Copyright 2019 Broadcom
# The term "Broadcom" refers to Broadcom Inc. and/or its subsidiaries.
#
# SPDX-License-Identifier: Apache-2.0
#

config SOC_FAMILY_BRCM_VK
	bool
	# omit prompt to signify a "hidden" option
	default n

if SOC_FAMILY_BRCM_VK
config SOC_FAMILY
	string
	default "brcm_vk"
endif

gsource "soc/arm/brcm_vk/*/Kconfig.soc"
```

## soc/arm/brcm_vk/valkyrie/Kconfig.defconfig.series
```kconfig
#
# Copyright 2019 Broadcom
# The term "Broadcom" refers to Broadcom Inc. and/or its subsidiaries.
#
# SPDX-License-Identifier: Apache-2.0
#

if SOC_SERIES_VALKYRIE

gsource "soc/arm/brcm_vk/valkyrie/Kconfig.defconfig.valkyrie*"

config SOC_SERIES
	default "valkyrie"

config NUM_IRQS
	default 255

config SYS_CLOCK_HW_CYCLES_PER_SEC
	int
	default 25000000

config FLASH_SIZE
	default 0

config FLASH_BASE_ADDRESS
	default 0

endif # SOC_SERIES_VALKYRIE
```

## soc/arm/brcm_vk/valkyrie/Kconfig.defconfig.valkyrie_bcm58400
```kconfig
#
# Copyright 2019 Broadcom
# The term "Broadcom" refers to Broadcom Inc. and/or its subsidiaries.
#
# SPDX-License-Identifier: Apache-2.0
#

if SOC_BCM58400

config SOC
	default "BCM58400"

endif # SOC_BCM58400
```

## soc/arm/brcm_vk/valkyrie/Kconfig.series
```kconfig
#
# Copyright 2019 Broadcom
# The term "Broadcom" refers to Broadcom Inc. and/or its subsidiaries.
#
# SPDX-License-Identifier: Apache-2.0
#

config SOC_SERIES_VALKYRIE
	bool "Broadcom Valkyrie Series"
	select SOC_FAMILY_BRCM_VK
	select ARM64
	select CPU_CORTEX_A72
	select ARM_ARCH_TIMER
	select GIC_V3
	select ARM_MMU
	help
	 Enable support for Broadcom Valkyrie Series
```

## soc/arm/brcm_vk/valkyrie/Kconfig.soc
```kconfig
#
# Copyright 2019 Broadcom
# The term "Broadcom" refers to Broadcom Inc. and/or its subsidiaries.
#
# SPDX-License-Identifier: Apache-2.0
#

choice
prompt "Broadcom Valkyrie SoC"
depends on SOC_SERIES_VALKYRIE

config SOC_BCM58400
	bool "Broadcom BCM58400"
endchoice
```
